## firmware/sdkconfig.defaults
```kconfig
# CPU
CONFIG_ESP32S3_DEFAULT_CPU_FREQ_240=y

# PSRAM (octal, 80MHz)
CONFIG_SPIRAM=y
CONFIG_SPIRAM_MODE_OCT=y
CONFIG_SPIRAM_SPEED_80M=y

# Cache
CONFIG_ESP32S3_DATA_CACHE_64KB=y
CONFIG_ESP32S3_DATA_CACHE_LINE_64B=y

# Camera
CONFIG_CAMERA_TASK_PINNED_TO_CORE_1=y

# Stack size
CONFIG_ESP_MAIN_TASK_STACK_SIZE=8192
```
